## drivers/sensor/tsl25721/Kconfig
```kconfig
# TSL25721 Proximity and Ambient Light Sensor configuration options

# Copyright (c) 2020 Richard Osterloh
# SPDX-License-Identifier: Apache-2.0

menuconfig TSL25721
	bool "TSL25721 Proximity and Ambient Light Sensor"
	default y
	depends on DT_HAS_AMS_TSL25721_ENABLED
	select I2C
	help
	  Enable driver for TSL25721 sensors.

if TSL25721

config TSL25721_ENABLE_ALS
	bool "Ambient light sensor"
	help
	  Enable Ambient Light Sense (ALS).

config TSL25721_TRIGGER
	bool

choice
	prompt "Trigger mode"
	default TSL25721_TRIGGER_NONE
	help
	  Specify the type of triggering to be used by the driver.

config TSL25721_TRIGGER_NONE
	bool "No trigger"

config TSL25721_TRIGGER_GLOBAL_THREAD
	bool "Use global thread"
	depends on GPIO
	select TSL25721_TRIGGER

config TSL25721_TRIGGER_OWN_THREAD
	bool "Use own thread"
	depends on GPIO
	select TSL25721_TRIGGER

endchoice

config TSL25721_THREAD_PRIORITY
	int "Thread priority"
	depends on TSL25721_TRIGGER_OWN_THREAD
	default 10
	help
	  Priority of thread used by the driver to handle interrupts.

config TSL25721_THREAD_STACK_SIZE
	int "Thread stack size"
	depends on TSL25721_TRIGGER_OWN_THREAD
	default 1024
	help
	  Stack size of thread used by the driver to handle interrupts.

endif # TSL25721
```
